## boards/shields/ultimate/kconfig.defconfig
```kconfig
if SHIELD_ULTIMATE_LEFT

# Name must be less than 16 characters long!
config ZMK_KEYBOARD_NAME
    default "ultimate"

config ZMK_SPLIT_ROLE_CENTRAL
    default y

endif

if SHIELD_ULTIMATE_LEFT || SHIELD_ULTIMATE_RIGHT

config ZMK_SPLIT
    default y

endif
```

## config/west.yml
```yaml
manifest:
  defaults:
    revision: v0.3
  remotes:
    - name: juan
      url-base: https://github.com/JuanLuisVegaAlonso
    # Additional modules containing boards/shields/custom code can be listed here as well
    # See https://docs.zephyrproject.org/3.2.0/develop/west/manifest.html#projects
    # START Joystick #####
    - name: badjeff
      url-base: https://github.com/badjeff
    # END #######
    # support nice_oled and nice_epaper
    - name: mctechnology17
      url-base: https://github.com/mctechnology17
  projects:
    # START Joystick #####
    - name: zmk-analog-input-driver
      remote: badjeff
      revision: main
    # END #######
    - name: zmk-with-oversampling-0
      remote: juan
      import: app/west.yml
      revision: v0.3.1
    # support nice_oled and nice_epaper
    - name: zmk-nice-oled
      remote: mctechnology17
      revision: main
  self:
    path: config
```
